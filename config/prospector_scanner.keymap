/*
 * Copyright (c) 2024 The ZMK Contributors
 *
 * SPDX-License-Identifier: MIT
 */

#include <behaviors.dtsi>
#include <dt-bindings/zmk/keys.h>
#include <dt-bindings/zmk/bt.h>
#include <dt-bindings/zmk/outputs.h>
#include <dt-bindings/zmk/pointing.h>

/ {
    keymap {
        compatible = "zmk,keymap";

        // Default layer - scanner has no physical keys
        default_layer {
            bindings = <&none>;
        };
    };

    // Layer listeners disabled - part of v2.0 Scanner Touch features
    /*
    // Mouse layer - auto-activated on cursor movement
    mouse_layer {
        bindings = <&none>;
    };

    // Layer listeners for auto-activating mouse gesture recognition
    layer_listeners {
        compatible = "zmk,layer-listeners";

        // Enable mouse gestures when layer 1 (mouse_layer) is active
        mouse_gesture {
            layers = <1>;
            bindings = <&mouse_gesture_on &mouse_gesture_off>;
        };
    };
    */
};

// Touch panel configuration disabled for battery bug investigation
// (v2.0 Scanner Touch features require CST816S hardware)
/*
// Include input processor modules
#include <input/processors.dtsi>
#include <dt-bindings/zmk/input_transform.h>
#include <zephyr/dt-bindings/input/input-event-codes.h>

#include <behaviors/input_processor_gestures.dtsi>
#include <behaviors/input_processor_absolute_to_relative.dtsi>
#include <mouse-gesture.dtsi>

// Alias touch_sensor to glidepoint for input gestures module compatibility
glidepoint: &touch_sensor {};

// Configure tap-to-click gesture detection
&zip_gestures {
    tap-detection;
    tap-timout-ms = <150>;       // 150ms tap timeout (note: property name has typo in binding)
    prevent_movement_during_tap;
};

// Configure mouse gesture recognition
&zip_mouse_gesture {
    stroke-size = <150>;         // Gesture stroke size
    enable-eager-mode;           // Immediate gesture recognition
    idle-timeout-ms = <200>;     // 200ms idle timeout before layer deactivation

    // Bootloader gesture: Swipe DOWN → RIGHT → UP
    bootloader {
        pattern = <GESTURE_DOWN GESTURE_RIGHT GESTURE_UP>;
        bindings = <&bootloader>;
    };
};

// Configure touch input processing pipeline
&touch_listener {
    input-processors = <
        &zip_gestures                                                  // Tap detection and trackpad gestures
        &zip_absolute_to_relative                                      // Convert absolute to relative coordinates
        &zip_xy_transform (INPUT_TRANSFORM_XY_SWAP | INPUT_TRANSFORM_Y_INVERT)  // Rotate 90° for display orientation
        &zip_xy_scaler 4 1                                            // 4x scaling for better cursor movement
        &zip_temp_layer 1 200                                          // Auto-activate layer 1 for 200ms on movement
        &zip_mouse_gesture                                            // Gesture recognition
    >;
};
*/
